## main/Kconfig.projbuild
```kconfig
menu "Ground Control"

    config GC_FW_VERSION
        int "Firmware version number reported in telemetry"
        default 1
        range 1 255

    config GC_SITE_ID
        int "Default site id (overridden by provisioning)"
        default 1
        range 1 65535

    config GC_DEVICE_ID
        int "Default device id (overridden by provisioning)"
        default 1
        range 1 65535

    config GC_MAX_CLIENTS
        int "Maximum concurrent portal clients"
        default 24
        range 1 32

    config GC_AP_SSID
        string "Default soft-AP SSID"
        default "groundcontrol"

    config GC_AP_PASSPHRASE
        string "Default soft-AP passphrase"
        default ""

    config GC_STA_SSID
        string "Default uplink SSID (B315)"
        default ""

    config GC_STA_PASSPHRASE
        string "Default uplink passphrase"
        default ""

    config GC_BROKER_URI
        string "MQTT broker URI (mqtts://host:port)"
        default ""

    config GC_MANIFEST_URL
        string "OTA manifest URL (https)"
        default ""

    config GC_BEACON_HOST
        string "Emergency beacon host"
        default ""

    config GC_BEACON_PORT
        int "Emergency beacon UDP port"
        default 41234
        range 1024 65535

    config GC_DAILY_BUDGET_KB
        int "Daily byte budget in KiB"
        default 1048576
        range 1024 16777216

    config GC_MONTHLY_RESERVE_KB
        int "Protected monthly reserve in KiB"
        default 614400
        range 1024 16777216

    config GC_CLIENT_RATE_KBYTE_S
        int "Per-client rate limit in KiB/s"
        default 128
        range 8 4096

    config GC_TELEMETRY_BATCH_S
        int "Telemetry batch period in seconds"
        default 3600
        range 60 86400

    config GC_MQTT_KEEPALIVE_S
        int "MQTT keepalive in seconds"
        default 300
        range 30 3600

    config GC_MODEM_POLL_S
        int "B315 poll period in seconds"
        default 300
        range 30 3600

    config GC_SOFT_BLOCK_S
        int "Soft block duration in seconds"
        default 86400
        range 60 604800

    config GC_STRIKE_LIMIT
        int "Strikes before a permanent block"
        default 3
        range 1 32

    config GC_ALLOW_GRACE_S
        int "Grace period granted on an allow verdict in seconds"
        default 3600
        range 60 604800

    config GC_SELFTEST_DEADLINE_S
        int "Self-test deadline in seconds"
        default 300
        range 30 900

    config GC_VERIFY_MODE_CHALLENGE
        bool "Use challenge mode instead of contact mode"
        default n

    config GC_RESCUE_IMAGE
        bool "Build the factory rescue image (no portal, beacon and OTA only)"
        default n

    config GC_BENCH_FAULTS
        bool "Enable bench fault injection hooks"
        default n

endmenu
```

## sdkconfig.defaults
```kconfig
CONFIG_ESPTOOLPY_FLASHSIZE_4MB=y
CONFIG_ESPTOOLPY_FLASHSIZE_AUTO=n
CONFIG_PARTITION_TABLE_CUSTOM=y
CONFIG_PARTITION_TABLE_CUSTOM_FILENAME="partitions.csv"
CONFIG_PARTITION_TABLE_OFFSET=0x8000
CONFIG_BOOTLOADER_OFFSET_IN_FLASH=0x1000

CONFIG_BOOTLOADER_APP_ROLLBACK_ENABLE=y
CONFIG_BOOTLOADER_APP_ANTI_ROLLBACK=n
CONFIG_BOOTLOADER_LOG_LEVEL_INFO=y

CONFIG_SECURE_BOOT=n
CONFIG_SECURE_FLASH_ENCRYPTION_ENABLED=n
CONFIG_SECURE_BOOT_ALLOW_ROM_BASIC=n
CONFIG_SECURE_BOOT_ALLOW_JTAG=n
CONFIG_SECURE_BOOT_ALLOW_EFUSE_RD_DIS=n

CONFIG_ESP32S2_SPIRAM_SUPPORT=y
CONFIG_SPIRAM=y
CONFIG_SPIRAM_MODE_QUAD=y
CONFIG_SPIRAM_TYPE_AUTO=y
CONFIG_SPIRAM_USE_MALLOC=y
CONFIG_SPIRAM_MALLOC_ALWAYSINTERNAL=4096
CONFIG_SPIRAM_TRY_ALLOCATE_WIFI_LWIP=n
CONFIG_SPIRAM_USE_CAPS_ALLOC=y

CONFIG_LWIP_IP_FORWARD=y
CONFIG_LWIP_IPV4_NAPT=y
CONFIG_LWIP_STATS=y
CONFIG_LWIP_MAX_SOCKETS=16
CONFIG_LWIP_TCPIP_TASK_PRIO=18
CONFIG_LWIP_DHCP_MAX_NTP_SERVERS=1
CONFIG_LWIP_DHCPS_MAX_STATION_NUM=24

CONFIG_ESP_MAIN_TASK_STACK_SIZE=8192
CONFIG_ESP_SYSTEM_EVENT_TASK_STACK_SIZE=4096
CONFIG_ESP_TIMER_TASK_STACK_SIZE=4096
CONFIG_ESP_TASK_WDT_EN=n
CONFIG_ESP_INT_WDT=n
CONFIG_ESP_PANIC_HANDLER_IRAM=n

CONFIG_LOG_DEFAULT_LEVEL_INFO=y
CONFIG_LOG_MAXIMUM_LEVEL_DEBUG=y
CONFIG_LOG_COLORS=n

CONFIG_MBEDTLS_TLS_CLIENT_ONLY=y
CONFIG_MBEDTLS_HARDWARE_AES=y
CONFIG_MBEDTLS_HARDWARE_SHA=y
CONFIG_MBEDTLS_DYNAMIC_BUFFER=y
CONFIG_MBEDTLS_DYNAMIC_FREE_PEER_CERT=y

CONFIG_ESP_WIFI_IRAM_OPT=n
CONFIG_ESP_WIFI_RX_IRAM_OPT=n
CONFIG_ESP_WIFI_ENABLE_WPA3_SAE=n
CONFIG_ESP_WIFI_TASK_PINNED_TO_CORE_0=n

CONFIG_FREERTOS_USE_TICKLESS_IDLE=n
CONFIG_FREERTOS_HZ=1000

CONFIG_ESP_HTTP_CLIENT_ENABLE_HTTPS=y
CONFIG_ESP_HTTPS_OTA_ALLOW_HTTP=n
```
